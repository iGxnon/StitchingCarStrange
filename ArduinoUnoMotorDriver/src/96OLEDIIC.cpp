/********************金逸晨**************************
*****************0.96  4PIN IIC OLED FOR Arduino*************
***** BY:GU
********************************************************/

#include <Wire.h>
#include <Arduino.h>

const unsigned char *point;

const unsigned char OLED_init_cmd[25] =
    {
        /*0xae,0X00,0X10,0x40,0X81,0XCF,0xff,0xa1,0xa4,
    0xA6,0xc8,0xa8,0x3F,0xd5,0x80,0xd3,0x00,0XDA,0X12,
    0x8d,0x14,0xdb,0x40,0X20,0X02,0xd9,0xf1,0xAF*/
        0xAE, //关闭显示
        0xD5, //设置时钟分频因子,震荡频率
        0x80, //[3:0],分频因子;[7:4],震荡频率
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        0xAF, //开启显示
};

const unsigned char picture_tab[] = {
    0xFF, 0x01, 0x01, 0x01, 0x01, 0x01, 0x01, 0x01, 0x01, 0x01, 0x01, 0x01, 0x01, 0x01, 0x01, 0x01,
    0x01, 0x01, 0x01, 0x01, 0x01, 0x01, 0x01, 0x01, 0x01, 0x01, 0x01, 0x01, 0x01, 0x01, 0x01, 0x01,
    0x01, 0x01, 0x01, 0x01, 0x01, 0x01, 0x01, 0x01, 0x01, 0x01, 0x01, 0x01, 0x01, 0x01, 0x01, 0x01,
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    0x80, 0x80, 0x80, 0x80, 0x80, 0x80, 0x80, 0x80, 0x80, 0x80, 0x80, 0x80, 0x80, 0x80, 0x80, 0xFF};

/**************************IIC模块发送函数************************************************

 *************************************************************************/
//写入  最后将SDA拉高，以等待从设备产生应答
void IIC_write(unsigned char date)
{
  unsigned char i, temp;
  temp = date;

  for (i = 0; i < 8; i++)
  {
    digitalWrite(SCL, LOW);

    if ((temp & 0x80) == 0)
      digitalWrite(SDA, LOW);
    else
      digitalWrite(SDA, HIGH);
    temp = temp << 1;
    //最少250ns延时
    digitalWrite(SCL, HIGH);
  }
  digitalWrite(SCL, LOW);

  digitalWrite(SDA, HIGH);

  digitalWrite(SCL, HIGH);
  //不进行应答检测
  digitalWrite(SCL, LOW);
}
//启动信号
//SCL在高电平期间，SDA由高电平向低电平的变化定义为启动信号
void IIC_start()
{
  digitalWrite(SDA, HIGH);

  digitalWrite(SCL, HIGH);
  //所有操作结束释放SCL
  digitalWrite(SDA, LOW);

  digitalWrite(SCL, LOW);

  IIC_write(0x78);
}

//停止信号
//SCL在高电平期间，SDA由低电平向高电平的变化定义为停止信号
void IIC_stop()
{
  digitalWrite(SDA, LOW);

  digitalWrite(SCL, HIGH);

  digitalWrite(SDA, HIGH);
}

void OLED_send_cmd(unsigned char o_command)
{

  IIC_start();
  IIC_write(0x00);
  IIC_write(o_command);
  IIC_stop();
}
void OLED_send_data(unsigned char o_data)
{
  IIC_start();
  IIC_write(0x40);
  IIC_write(o_data);
  IIC_stop();
}
void Column_set(unsigned char column)
{
  OLED_send_cmd(0x10 | (column >> 4));   //设置列地址高位
  OLED_send_cmd(0x00 | (column & 0x0f)); //设置列地址低位
}
void Page_set(unsigned char page)
{
  OLED_send_cmd(0xb0 + page);
}
void OLED_clear(void)
{
  unsigned char page, column;
  for (page = 0; page < 8; page++) //pageloop
  {
    Page_set(page);
    Column_set(0);
    for (column = 0; column < 128; column++) //columnloop
    {
      OLED_send_data(0x00);
    }
  }
}
void OLED_full(void)
{
  unsigned char page, column;
  for (page = 0; page < 8; page++) //pageloop
  {
    Page_set(page);
    Column_set(0);
    for (column = 0; column < 128; column++) //columnloop
    {
      OLED_send_data(0xff);
    }
  }
}
void OLED_init(void)
{
  unsigned char i;
  for (i = 0; i < 25; i++)
  {
    OLED_send_cmd(OLED_init_cmd[i]);
  }
}

/// 将一个char串展示
void Picture_display(const unsigned char *ptr_pic)
{
  unsigned char page, column;
  for (page = 0; page < (64 / 8); page++) //pageloop
  {
    Page_set(page);
    Column_set(0);
    for (column = 0; column < 128; column++) //columnloop
    {
      OLED_send_data(*ptr_pic++);
    }
  }
}

/// 反转展示
void Picture_ReverseDisplay(const unsigned char *ptr_pic)
{
  unsigned char page, column, data;
  for (page = 0; page < (64 / 8); page++) //pageloop
  {
    Page_set(page);
    Column_set(0);
    for (column = 0; column < 128; column++) //columnloop
    {
      data = *ptr_pic++;
      data = ~data;
      OLED_send_data(data);
    }
  }
}

void IO_init(void)
{
  pinMode(SCL, OUTPUT); //设置数字脚为输出 SCL
  pinMode(SDA, OUTPUT); //设置数字脚为输出 SDA
}

void OLED_INIT()
{
  point = &picture_tab[0];
  IO_init();
  OLED_init();
  OLED_full();
  delay(1000);
  OLED_clear();
}
